# CY8C4245AXI_483 register map
File version: 0.1
PSoC 4200
Registers are 8-bit, read-write, no defined reset value unless marked. A register's access mark holds for its fields unless they carry their own. Offsets are from the block's base; lines under a group give offsets from that group; [hi:lo] are bit positions; {n}, {i} and the like mark numbered series; 'fields as' and 'values as' point back to an identical list; <NAME> marks a mode.

## Memory map
0x400F0070 SSCR size 0x1

## SSCR
Base 0x400F0070
0x00 SSCR_CONTROL_REG
